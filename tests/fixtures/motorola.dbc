VERSION "1.0"
BS_:
BU_: ECU Dash
BO_ 292 Motorola: 8 ECU
 SG_ Unaligned : 2|5@0+ (1,0) [0|31] "" Dash
 SG_ Signed12 : 23|12@0- (0.5,-10) [-1034|1013.5] "V" Dash
