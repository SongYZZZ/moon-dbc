VERSION "1.0"
NS_ :

BS_:
BU_: ECU Dash
BO_ 291 EngineData: 8 ECU
 SG_ EngineSpeed : 0|16@1+ (0.125,0) [0|8000] "rpm" Dash
 SG_ Gear : 16|8@1+ (1,0) [0|7] "" Dash
VAL_ 291 Gear 0 "Park" 3 "Drive";
