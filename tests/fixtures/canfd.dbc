VERSION "1.0"
BS_:
BU_: ECU Dash
BO_ 2147483942 CANFD: 64 ECU
 SG_ Tail : 504|8@1+ (1,0) [0|255] "" Dash
 SG_ FullUnsigned : 0|64@1+ (1,0) [0|18446744073709551615] "" Dash
