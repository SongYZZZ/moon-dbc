VERSION "1.0"
NS_ :

BS_:
BU_: ECU Dash
BO_ 300 PreciseUnsigned: 8 ECU
 SG_ Value : 0|64@1+ (1,0) [0|9007199254740991] "" Dash
